## asic/os/ulinux_asic_kianv_soc/bldroot/configs/kianv_rv32ima_buildroot_defconfig
```kconfig
BR2_riscv=y
BR2_riscv_custom=y
BR2_RISCV_ISA_RVM=y
BR2_RISCV_32=y
# BR2_RISCV_USE_MMU is not set
BR2_PTHREADS_NONE=y
# BR2_UCLIBC_INSTALL_UTILS is not set
BR2_TARGET_OPTIMIZATION="-Os"
BR2_TARGET_LDFLAGS="-s"
BR2_BACKUP_SITE="http://sources.buildroot.net"
BR2_CPAN_MIRROR="http://cpan.metacpan.org"
BR2_ENABLE_LTO=y
BR2_GLOBAL_PATCH_DIR="board/qemu/riscv32-virt/nommu/patches"
BR2_TARGET_GENERIC_ISSUE="Welcome to KianV ASIC Buildroot"
# BR2_TARGET_ENABLE_ROOT_LOGIN is not set
# BR2_TARGET_GENERIC_GETTY is not set
BR2_ROOTFS_OVERLAY="rootfs-overlay"
BR2_ROOTFS_POST_IMAGE_SCRIPT="board/qemu/post-image.sh"
BR2_ROOTFS_POST_SCRIPT_ARGS="$(BR2_DEFCONFIG)"
BR2_LINUX_KERNEL=y
BR2_LINUX_KERNEL_CUSTOM_VERSION=y
BR2_LINUX_KERNEL_CUSTOM_VERSION_VALUE="6.8-rc1"
BR2_LINUX_KERNEL_USE_CUSTOM_CONFIG=y
BR2_LINUX_KERNEL_CUSTOM_CONFIG_FILE="board/kianv/rv32ima/linux.config"
BR2_PACKAGE_BUSYBOX_CONFIG="package/busybox/kianv_busybox.config"
# BR2_PACKAGE_IFUPDOWN_SCRIPTS is not set
# BR2_PACKAGE_URANDOM_SCRIPTS is not set
BR2_TARGET_ROOTFS_INITRAMFS=y
# BR2_TARGET_ROOTFS_TAR is not set
BR2_PACKAGE_HOST_E2FSPROGS=y
BR2_PACKAGE_HOST_MKPASSWD=y
BR2_PACKAGE_HOST_QEMU=y
BR2_PACKAGE_HOST_QEMU_SYSTEM_MODE=y
```

## linux_socs/kianv_mc_rv32ima_sv32/buildroot-kianv-soc/bldroot/configs/kianv_rv32ima_sv32_buildroot_defconfig
```kconfig
BR2_riscv=y
BR2_riscv_custom=y
BR2_RISCV_ISA_RVM=y
BR2_RISCV_ISA_RVA=y
BR2_RISCV_32=y
BR2_GCC_VERSION_13_X=y
BR2_TOOLCHAIN_BUILDROOT_CXX=y
BR2_CCACHE=y
BR2_OPTIMIZE_S=y
BR2_GLOBAL_PATCH_DIR="board/kianv/rv32ima_sv32/patches"
BR2_ROOTFS_MERGED_USR=y
BR2_SYSTEM_DEFAULT_PATH="/bin:/sbin:/usr/bin:/usr/sbin"
BR2_ROOTFS_OVERLAY="rootfs-overlay"
BR2_ROOTFS_POST_IMAGE_SCRIPT="board/qemu/post-image.sh"
BR2_ROOTFS_POST_SCRIPT_ARGS="$(BR2_DEFCONFIG)"
BR2_LINUX_KERNEL=y
BR2_LINUX_KERNEL_CUSTOM_VERSION=y
BR2_LINUX_KERNEL_CUSTOM_VERSION_VALUE="6.6.8"
BR2_LINUX_KERNEL_USE_CUSTOM_CONFIG=y
BR2_LINUX_KERNEL_CUSTOM_CONFIG_FILE="board/kianv/rv32ima_sv32/linux.config"
BR2_PACKAGE_BUSYBOX_CONFIG="package/busybox/kianv_busybox.config"
BR2_PACKAGE_FLEX=y
BR2_PACKAGE_E2TOOLS=y
BR2_PACKAGE_ASCII_INVADERS=y
BR2_PACKAGE_XORCURSES=y
BR2_PACKAGE_MICROPYTHON=y
BR2_PACKAGE_SQLITE=y
BR2_PACKAGE_UTF8PROC=y
# BR2_PACKAGE_IFUPDOWN_SCRIPTS is not set
BR2_PACKAGE_LIGHTTPD=y
BR2_PACKAGE_LYNX=y
BR2_PACKAGE_NTP=y
BR2_PACKAGE_NTP_NTPDATE=y
BR2_PACKAGE_OPENSSH=y
# BR2_PACKAGE_OPENSSH_SANDBOX is not set
BR2_PACKAGE_RPCBIND=y
BR2_PACKAGE_TINYSSH=y
BR2_PACKAGE_UFTP=y
# BR2_PACKAGE_URANDOM_SCRIPTS is not set
BR2_PACKAGE_TMUX=y
BR2_PACKAGE_ATOP=y
BR2_PACKAGE_CPULOAD=y
BR2_PACKAGE_HTOP=y
BR2_PACKAGE_UTIL_LINUX_LIBMOUNT=y
BR2_TARGET_ROOTFS_CPIO=y
BR2_TARGET_ROOTFS_EXT2=y
BR2_TARGET_OPENSBI=y
BR2_TARGET_OPENSBI_CUSTOM_VERSION=y
BR2_TARGET_OPENSBI_CUSTOM_VERSION_VALUE="1.4"
BR2_TARGET_OPENSBI_PLAT="fpga/kianv"
# BR2_TARGET_OPENSBI_INSTALL_DYNAMIC_IMG is not set
# BR2_TARGET_OPENSBI_INSTALL_JUMP_IMG is not set
BR2_TARGET_OPENSBI_LINUX_PAYLOAD=y
BR2_TARGET_OPENSBI_ADDITIONAL_VARIABLES="BUILD_INFO=y PLATFORM_RISCV_XLEN=32 FW_FDT_PATH=$(TOPDIR)/board/kianv/rv32ima_sv32/kianv.dtb"
BR2_PACKAGE_HOST_QEMU=y
BR2_PACKAGE_HOST_QEMU_SYSTEM_MODE=y
```
